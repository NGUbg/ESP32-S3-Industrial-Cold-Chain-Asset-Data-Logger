## cold-chain-logger/sdkconfig.defaults
```kconfig
# === Target ===
CONFIG_IDF_TARGET="esp32s3"

# === CPU ===
CONFIG_ESP_DEFAULT_CPU_FREQ_MHZ_240=y
CONFIG_ESP_DEFAULT_CPU_FREQ_MHZ=240

# === PSRAM ===
CONFIG_SPIRAM=y
CONFIG_SPIRAM_MODE_OCT=y
CONFIG_SPIRAM_TYPE_AUTO=y
CONFIG_SPIRAM_BOOT_INIT=y
CONFIG_SPIRAM_USE_MALLOC=y

# === FreeRTOS ===
CONFIG_ESP_MAIN_TASK_STACK_SIZE=8192
CONFIG_FREERTOS_HZ=1000
CONFIG_FREERTOS_TIMER_TASK_STACK_DEPTH=4096
CONFIG_FREERTOS_USE_TICKLESS_IDLE=y

# === Partition table (OTA + LittleFS) ===
CONFIG_PARTITION_TABLE_CUSTOM=y
CONFIG_PARTITION_TABLE_CUSTOM_FILENAME="partitions.csv"

# === Wi-Fi ===
CONFIG_ESP_WIFI_ENABLED=y
CONFIG_ESP_WIFI_STATIC_RX_BUFFER_NUM=10
CONFIG_ESP_WIFI_DYNAMIC_RX_BUFFER_NUM=32
CONFIG_ESP_WIFI_DYNAMIC_TX_BUFFER_NUM=32

# === BLE + Provisioning ===
CONFIG_BT_ENABLED=y
CONFIG_BT_NIMBLE_ENABLED=y
CONFIG_BT_NIMBLE_MAX_CONNECTIONS=1
CONFIG_WIFI_PROV_TRANSPORT_BLE=y
CONFIG_WIFI_PROV_BLE_SEC_CONN=y

# === MQTT over TLS ===
CONFIG_MQTT_PROTOCOL_5=y
CONFIG_MQTT_TRANSPORT_SSL=y
CONFIG_MQTT_TASK_STACK_SIZE=6144

# === TLS (mbedTLS) ===
CONFIG_MBEDTLS_SSL_MAX_CONTENT_LEN=16384
CONFIG_MBEDTLS_CERTIFICATE_BUNDLE=y
CONFIG_MBEDTLS_CERTIFICATE_BUNDLE_DEFAULT_FULL=y

# === OTA + Rollback ===
CONFIG_ESP_HTTPS_OTA_ALLOW_HTTP=n
CONFIG_BOOTLOADER_APP_ROLLBACK_ENABLE=y
CONFIG_APP_ROLLBACK_ENABLE=y

# === Power Management + Deep Sleep ===
CONFIG_PM_ENABLE=y
CONFIG_ESP_SLEEP_GPIO_RESET_WORKAROUND=y

# === Watchdog + Brown-out ===
CONFIG_ESP_TASK_WDT_EN=y
CONFIG_ESP_TASK_WDT_TIMEOUT_S=10
CONFIG_ESP_BROWNOUT_DET=y
CONFIG_ESP_BROWNOUT_DET_LVL_SEL_7=y

# === NVS ===
CONFIG_NVS_ENCRYPTION=y
```
